
#include "mod.h"
#include "sys.h"

usart_st  usart_data;
modbus_rtust  modbus_data;



/* CRC 高位字节值表 */
	const u8 AUCHCRCHI[256]=
	{
		0x00,0x0C1,0x81,0x40,0x01,0x0C0,0x80,0x41,
		0x01,0x0C0,0x80,0x41,0x00,0x0C1,0x81,0x40,
		0x01,0x0C0,0x80,0x41,0x00,0x0C1,0x81,0x40,
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		0x01,0x0C0,0x80,0x41,0x00,0x0C1,0x81,0x40
	};
	

	 /* CRC 低位字节值表 */
	const uint8_t AUCHCRCLO[256]=
	{
		0,0xC0,0xC1,0x01,0xC3,0x03,0x02,0xC2,
		0xC6,0x06,0x07,0xC7,0x05,0xC5,0xC4,0x04,
		0xCC,0x0C,0x0D,0xCD,0x0F,0xCF,0xCE,0x0E,
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		0x82,0x42,0x43,0x83,0x41,0x81,0x80,0x40 
	};
	


	

	
	unsigned char com_485_send(unsigned int l)
{
	if(usart_data.tx_len==0)
	{
		usart_data.tx_len=l;
		RT_485_T;
		usart_data.tx_len_ed=0;
	  usart_data.deal_flag=1;
		usart_data.t_time_delay=0;
		USART_ITConfig(modUSARTx, USART_IT_TXE, ENABLE);
		return 1;
	}
	return 0;
}
	

//使用CRC16校验
//计算方式： 
//buf:待校验缓冲区首地址
//len:要校验的长度
//返回值：CRC16校验值（高字节在前，低字节在后）  
u16 mc_check_crc16(u8 *buf,u16 len)
{
	u8 index;
	u16 check16=0;
	u8 crc_low=0XFF;
	u8 crc_high=0XFF;
	while(len--)
	{
		index=crc_high^(*buf++);
		crc_high=crc_low^AUCHCRCHI[index];
		crc_low=AUCHCRCLO[index];
	}
	check16 +=crc_high;
	check16 <<=8;
	check16+=crc_low;
	return check16;
}
	
	/*函数名:Modbus_CRC16
	**功能描述： crc校验
**参数： data_buf发送区数据    data_len   数据长度
	*/
uint16_t Modbus_CRC16( uint8_t *data_buf,uint16_t data_len) 
{
  uint16_t i;
	uint8_t j,ch,cl;
  ch=0xff;
  cl=0xff;
	for(i=0;i<data_len;i++)
	{
	  j=data_buf[i];
		j=ch^j;
		ch=cl^AUCHCRCHI[(j&0xff)];
		cl = AUCHCRCLO[(j&0xff)];
	}
	return(((unsigned short int)ch) * 0x100 + ((unsigned short int)cl));
}

/*函数名:  read_hold_register_03
	**功能描述：读保持寄存器
	**参数：dev_add：从机地址，addr：通讯地址，len：地址个数
	*/
signed char read_hold_register_03(unsigned char dev_add,unsigned short int addr,unsigned short int len)
{
	unsigned char i;
	unsigned short int crc;
	unsigned int addr_edd;
	addr_edd=(unsigned int)addr+(unsigned int)len-1;
	 modbus_data.dev_add=dev_add;
	 modbus_data.fun=0x03;
	 modbus_data.addr=addr;
	 modbus_data.len=len;
	 i=0;
	 usart_data.tx_buf[i++]=modbus_data.dev_add; //从机地址
	 usart_data.tx_buf[i++]=modbus_data.fun;     //功能码
	 usart_data.tx_buf[i++]=modbus_data.addr>>8;  //获取地址高8位
	 usart_data.tx_buf[i++]=modbus_data.addr;     //获取地址低8位
	 usart_data.tx_buf[i++]=modbus_data.len>>8;   //获取长度高8位
	 usart_data.tx_buf[i++]=modbus_data.len;      //获取长度低8位
	 crc=Modbus_CRC16(usart_data.tx_buf,i);        //crc校验
	 usart_data.tx_buf[i++]=crc>>8;
	 usart_data.tx_buf[i++]=crc;
	 usart_data.rx_len_ed=0;
	 com_485_send(i);
}






